## boards/shields/ZaruBall/Kconfig.shield
```kconfig
#No whitespace after the comma or in your part name!
config SHIELD_ZARUBALL_LEFT
	def_bool $(shields_list_contains,ZaruBall_left)

config SHIELD_ZARUBALL_RIGHT
	def_bool $(shields_list_contains,ZaruBall_right)
```

## config/west.yml
```yaml
manifest:
  remotes:
    - name: zmkfirmware
      url-base: https://github.com/zmkfirmware
    - name: badjeff
      url-base: https://github.com/badjeff
    - name: caksoylar
      url-base: https://github.com/caksoylar
    - name: kumamuk-git
      url-base: https://github.com/kumamuk-git
  projects:
    - name: zmk
      remote: zmkfirmware
      revision: v0.3
      import: app/west.yml
    - name: zmk-pmw3610-driver
      remote: kumamuk-git
      revision: main
    - name: zmk-rgbled-widget
      remote: caksoylar
      revision: v0.3-branch
  self:
    path: config
```
